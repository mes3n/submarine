## layers/meta-submarine/conf/layer.conf
```bitbake
# We have a conf and classes directory, add to BBPATH
BBPATH .= ":${LAYERDIR}"

# We have recipes-* directories, add to BBFILES
BBFILES += "${LAYERDIR}/recipes-*/*/*.bb \
            ${LAYERDIR}/recipes-*/*/*.bbappend"

BBFILE_COLLECTIONS += "submarine"
BBFILE_PATTERN_submarine = "^${LAYERDIR}/"
BBFILE_PRIORITY_submarine = "6"
LAYERSERIES_COMPAT_submarine = "scarthgap"
```
